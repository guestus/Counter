/*
 * Homeyduino firmware for Sonoff Basic
 * 
 * WARNING:
 * Never try to program a Sonoff which is connected to the mains! Failure to
 * disconnect mains before connecting the usb to serial converter will cause
 * damage to you and your equipment.
 * 
 * Always power the Sonoff using an external 3.3v source while programming.
 * 
 */

// -- CONFIGURATION --------------------------------------------------------------

/* Comment out (//) lines to disable the feature */

#define BUTTON_SWITCHES_OUTPUT //Have the button toggle the relay directly
                               //(if disabled the button will only send a trigger)

#define LED_SHOWS_OUTPUT_STATE //Have the led show the state of the relay
                               //(if disabled led can be controlled using an action)

//--------------------------------------------------------------------------------

#include <ESP8266WiFi.h>
#include <WiFiClient.h>
#include <DNSServer.h>
#include <ESP8266WebServer.h>
#include <WiFiManager.h>
#include <SoftwareSerial.h>
#include <Homey.h>

#if defined(ESP8266) && !defined(D5)
#define D5 (14)
#define D6 (12)
#define D7 (13)
#define D8 (15)
#endif


WiFiManager wifiManager;
SoftwareSerial readerSerial; //(13,15,false,256);

unsigned long previousMillis = 0;
const unsigned long interval = 5000; //Interval in milliseconds

void setup() {
  Serial.begin(115200);
  //readerSerial.begin(9600);
  readerSerial.begin(9600, SWSERIAL_8N1, D5, D6, false, 95, 11);
  
  String deviceName = "Mercury-" + String(ESP.getChipId()); //Generate device name based on ID

  Serial.println("wifiManager...");
  wifiManager.autoConnect(deviceName.c_str(), ""); //Start wifiManager
  Serial.println("Connected!");
  
  Homey.begin(deviceName, "Mercury"); //Start Homeyduino
  Homey.setClass("sensor");
  Homey.addCapability("measure_voltage");
  Homey.addCapability("measure_current");
  Homey.addCapability("measure_power");
  Homey.addCapability("meter_powerXday");
  Homey.addCapability("meter_powerXnight");
  Serial.println("..exit setup");

}

void loop() {
  Homey.loop();
  unsigned long currentMillis = millis();
  if(currentMillis - previousMillis > interval) {
    previousMillis = currentMillis;
    Serial.println("Updating capability...");
    UpdateCapability();
    Serial.println("exit Updating capability...");
  }
}


void UpdateCapability() {
}


int crc16_modbus(String str1) {
  const byte auchCRCHi[]  = { 0x00, 0xC1, 0x81, 0x40, 0x01, 0xC0, 0x80, 0x41, 0x01, 0xC0, 0x80, 0x41, 0x00, 0xC1, 0x81,
                              0x40, 0x01, 0xC0, 0x80, 0x41, 0x00, 0xC1, 0x81, 0x40, 0x00, 0xC1, 0x81, 0x40, 0x01, 0xC0,
                              0x80, 0x41, 0x01, 0xC0, 0x80, 0x41, 0x00, 0xC1, 0x81, 0x40, 0x00, 0xC1, 0x81, 0x40, 0x01,
                              0xC0, 0x80, 0x41, 0x00, 0xC1, 0x81, 0x40, 0x01, 0xC0, 0x80, 0x41, 0x01, 0xC0, 0x80, 0x41,
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                              0x00, 0xC1, 0x81, 0x40, 0x01, 0xC0, 0x80, 0x41, 0x01, 0xC0, 0x80, 0x41, 0x00, 0xC1, 0x81,
                              0x40
                            };
  const byte auchCRCLo[]=  {  0x00, 0xC0, 0xC1, 0x01, 0xC3, 0x03, 0x02, 0xC2, 0xC6, 0x06, 0x07, 0xC7, 0x05, 0xC5, 0xC4,
                              0x04, 0xCC, 0x0C, 0x0D, 0xCD, 0x0F, 0xCF, 0xCE, 0x0E, 0x0A, 0xCA, 0xCB, 0x0B, 0xC9, 0x09,
                              0x08, 0xC8, 0xD8, 0x18, 0x19, 0xD9, 0x1B, 0xDB, 0xDA, 0x1A, 0x1E, 0xDE, 0xDF, 0x1F, 0xDD,
                              0x1D, 0x1C, 0xDC, 0x14, 0xD4, 0xD5, 0x15, 0xD7, 0x17, 0x16, 0xD6, 0xD2, 0x12, 0x13, 0xD3,
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                              0x44, 0x84, 0x85, 0x45, 0x87, 0x47, 0x46, 0x86, 0x82, 0x42, 0x43, 0x83, 0x41, 0x81, 0x80,
                              0x40
                           };
  int len  = str1.length();
  int uchCRCHi   = 0xFF;
  int uchCRCLo   = 0xFF;
  int uIndex     = 0;
  for (int i = 0; i < len; i++) {
    uIndex     = uchCRCLo ^ str1.charAt(i);
    uchCRCLo   = uchCRCHi ^ auchCRCHi[uIndex];
    uchCRCHi   = auchCRCLo[uIndex] ;
  }
  return uchCRCLo*256+uchCRCHi;
}


String nice_hex(String str1) {
  String res;
  str1.toUpperCase();
  while (str1.length()>0) {
    res= res+str1.substring(0,2);
    str1.remove(0,2);
    if (str1.length()>0) {
      res+=' ';
    }
  }
  return res;
}

void process_counter() {
  String cmd="0056584163";  // 00 + 0EB6DE Адрес + 63 команда
  cmd+= String(crc16_modbus(cmd), HEX);
  
  //digitalWrite(D0, HIGH);
  delayMicroseconds(1);
  readerSerial.print(cmd);
  String res;
  //digitalWrite(D0, LOW);
  delayMicroseconds(1);
  while (readerSerial.available()>0) {
    res+= String(Serial.read(),HEX); 
    yield();
  }
  delayMicroseconds(20);

  //digitalWrite(D0, HIGH);
  delayMicroseconds(1);
  String res2;
  cmd= "0056584127"; // 00 + 0EB6DE Адрес + 27 команда
  cmd+= String(crc16_modbus(cmd), HEX);
  Serial.print(cmd);
  delayMicroseconds(1);
  while (Serial.available()>0) {
    res2+= String(Serial.read(),HEX); 
    yield();
  }
  delayMicroseconds(20);
  int Uv= atoi(("0x"+res.substring(0, 2)).c_str()) / 10;
  int Ia= atoi(("0x"+res.substring(2, 4)).c_str()) / 100;
  int Pv= atoi(("0x"+res.substring(4, 7)).c_str()) / 1000;
  int tarif=  atoi(("0x"+res2.substring(0, 4)).c_str()) / 100;
  int tarif2= atoi(("0x"+res2.substring(4, 8)).c_str()) / 100;

  Homey.setCapabilityValue("measure_voltage", Uv);
  Homey.setCapabilityValue("measure_current", Ia);
  Homey.setCapabilityValue("measure_power", Pv);
  Homey.setCapabilityValue("meter_powerXday", tarif);
  Homey.setCapabilityValue("meter_powerXnight", tarif2);
}  
